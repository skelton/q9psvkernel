/*
 * RockChip. LCD_B101ew05
 *
 */

/ {

		disp_timings: display-timings {
                        native-mode = <&timing0>;
                        timing0: timing0 {
				screen-type = <SCREEN_RGB>;
				lvds-format = <LVDS_8BIT_2>;
				out-face    = <OUT_D888_P666>;
				clock-frequency = <50000000>;
				hactive = <1024>;
				vactive = <600>;
				hback-porch = <140>;
				hfront-porch = <109>;
				vback-porch = <20>;
				vfront-porch = <13>;
				hsync-len = <20>;
				vsync-len = <10>;
				hsync-active = <0>;
				vsync-active = <0>;
				de-active = <0>;
				pixelclk-active = <0>;
				swap-rb = <0>;
				swap-rg = <0>;
				swap-gb = <0>;
                     	};
               };
};
